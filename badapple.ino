#include <U8g2lib.h>
#include <SPI.h>
#include <SD.h>
#define CSPIN D4
//U8G2_ST7920_128X64_F_8080 u8g2(U8G2_R2, 22, 23, 24, 25, 26, 27, 28, 29, /*enable=*/ 10, /*cs=*/ U8X8_PIN_NONE, /*dc/rs=*/ 12, /*reset=*/ 9); // Remember to set R/W to 0
////lcd:                                  D7,D6,D5,D4,D3,D2,D1,D0
////                                      |  |  |  |  |  |  |  |
////mega2560:                             22,23,24,25,26,27,28,29
U8G2_ST7920_128X64_F_SW_SPI u8g2(U8G2_R2, /* clock=*/ D1, /* data=*/ D2, /* CS=*/ D3, /* reset=*/ D0);
File myFile;
#define SERIAL_DEBUG_ON  //是否启动编译串口调试信息
const byte nBitmapDot[] =                  // 开始图片
{
  0x00, 0x00, 0x00, 0x00, 0x00, 0x00, 0x00, 0x00,
  0x00, 0x00, 0x00, 0x00, 0x00, 0x00, 0x00, 0x00,
  0x00, 0x00, 0x00, 0x00, 0x00, 0x00, 0x00, 0xE0,
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  0xFF, 0xFF, 0x01, 0x00, 0x00, 0x00, 0x00, 0x00
};
void setup(void) {
  //  pinMode(13, OUTPUT);
  //  digitalWrite(13, LOW);
  //  pinMode(11, OUTPUT);
#ifdef SERIAL_DEBUG_ON
  Serial.begin(115200);
  Serial.println("START!");
#endif

  //  digitalWrite(11, 0);  // set R/W to 0
  u8g2.begin();

  if (!SD.begin(CSPIN)) {
#ifdef SERIAL_DEBUG_ON
    Serial.println("SD card initialization failed");
#endif
    u8g2.setFont(u8g2_font_5x7_mf);
    u8g2.clearBuffer();
    u8g2.drawStr(1, 10, "SD card not found.");
    u8g2.sendBuffer();
    delay(100);
    while (1);
  }

}


byte buf[704];
char str[12];
char number[5];
void loop(void) {
  int n = 1;
  u8g2.clearBuffer();
  u8g2.drawXBM(0, 0, 128, 64, nBitmapDot);
  u8g2.sendBuffer();
  delay(3500);
  u8g2.clear();
  u8g2.setFont(u8g2_font_ncenB08_tr);
  if (!SD.exists("all.bin")) {
    u8g2.setFont(u8g2_font_5x7_mf);
    u8g2.clearBuffer();
    u8g2.drawStr(1, 10, "all.bin not found.");
    u8g2.sendBuffer();
    while (1);
  }
  myFile = SD.open("all.bin"); //open the bin
  if (!myFile) {
    u8g2.setFont(u8g2_font_5x7_mf);
    u8g2.clearBuffer();
    u8g2.drawStr(1, 10, "open file error.");
    u8g2.sendBuffer();
    while (1);
  }

  for (int i = 0; i < 2625; i++) {
    snprintf(number, 6, "%d", n);
#ifdef SERIAL_DEBUG_ON
    Serial.print("Picture:");
    Serial.println(number);
#endif
    for (int j = 0; j < 704; j++) {
      buf[j] = myFile.read();
    }
    u8g2.clearBuffer();
    u8g2.drawXBM(0, 0, 88, 64, buf);//draw picture
    u8g2.drawStr(94, 20, "Page:");
    u8g2.drawStr(96, 40, number); //draw the number
    u8g2.drawFrame(91, 3, 34, 58);
    u8g2.sendBuffer();
    n++;//to next picture
  }
#ifdef SERIAL_DEBUG_ON
  Serial.println("It's over.");
#endif
  u8g2.setFont(u8g2_font_lubI14_tf);
  u8g2.clearBuffer();
  u8g2.drawStr(10, 19, "Thanks");
  u8g2.drawStr(20, 39, "for your");
  u8g2.drawStr(30, 59, "watching");
  u8g2.sendBuffer();
  delay(5000);
}
